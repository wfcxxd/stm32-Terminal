#include "ssd1306.h"
#include <string.h>

extern SPI_HandleTypeDef hspi1;

static uint8_t s_buf[SSD1306_WIDTH * SSD1306_PAGES];

static void ssd1306_cmd(uint8_t cmd){
  OLED_DC_Cmd(); OLED_CS_L();
  HAL_SPI_Transmit(&hspi1, &cmd, 1, HAL_MAX_DELAY);
  OLED_CS_H();
}
static void ssd1306_data(const uint8_t* data, uint16_t len){
  OLED_DC_Data(); OLED_CS_L();
  HAL_SPI_Transmit(&hspi1, (uint8_t*)data, len, HAL_MAX_DELAY);
  OLED_CS_H();
}

/* 5x7 ASCII 字库（0x20~0x7E） */
static const uint8_t FONT5x7[95][5] = {
{0,0,0,0,0},{0,0,0x5F,0,0},{0,0x07,0,0x07,0},{0x14,0x7F,0x14,0x7F,0x14},
{0x24,0x2A,0x7F,0x2A,0x12},{0x23,0x13,0x08,0x64,0x62},{0x36,0x49,0x55,0x22,0x50},
{0,0x05,0x03,0,0},{0,0x1C,0x22,0x41,0},{0,0x41,0x22,0x1C,0},{0x14,0x08,0x3E,0x08,0x14},
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{0,0x08,0x36,0x41,0},{0,0,0x7F,0,0},{0,0x41,0x36,0x08,0},{0x10,0x08,0x08,0x10,0x08}
};

/* 基础绘图与文本 */
void SSD1306_Fill(uint8_t on){ memset(s_buf, on ? 0xFF : 0x00, sizeof(s_buf)); }

void SSD1306_DrawPixel(uint16_t x, uint16_t y, uint8_t on){
  if(x>=SSD1306_WIDTH || y>=SSD1306_HEIGHT) return;
  uint32_t idx = x + (y/8)*SSD1306_WIDTH;
  uint8_t  mask = 1 << (y & 7);
  if(on) s_buf[idx] |= mask; else s_buf[idx] &= ~mask;
}

void SSD1306_DrawChar(int x,int y,char c){
  if(c < 0x20 || c > 0x7E) c = '?';
  const uint8_t* col = FONT5x7[c-0x20];
  for(int i=0;i<5;i++){
    uint8_t bits = col[i];
    for(int j=0;j<7;j++) SSD1306_DrawPixel(x+i, y+j, (bits>>j)&1);
  }
}

void SSD1306_DrawString(int x,int y,const char* s){
  int cx = x;
  while(*s){
    if(*s=='\n'){ y+=8; cx=x; s++; continue; }
    SSD1306_DrawChar(cx,y,*s++);
    cx += 6;
    if(cx+6 >= SSD1306_WIDTH){ y+=8; cx=x; }
  }
}

/* 刷新 */
void SSD1306_Update(void){
  ssd1306_cmd(0x21); ssd1306_cmd(0x00 + SSD1306_COL_OFFSET); ssd1306_cmd(SSD1306_WIDTH-1 + SSD1306_COL_OFFSET);
  ssd1306_cmd(0x22); ssd1306_cmd(0x00); ssd1306_cmd(SSD1306_PAGES-1);
  ssd1306_data(s_buf, sizeof(s_buf));
}

/* 初始化 */
void SSD1306_Init(void){
  OLED_RST_L(); HAL_Delay(5); OLED_RST_H(); HAL_Delay(5);

  ssd1306_cmd(0xAE);
  ssd1306_cmd(0xD5); ssd1306_cmd(0x80);
  ssd1306_cmd(0xA8); ssd1306_cmd(0x3F);
  ssd1306_cmd(0xD3); ssd1306_cmd(0x00);
  ssd1306_cmd(0x40 | 0x00);
  ssd1306_cmd(0x8D); ssd1306_cmd(0x14);
  ssd1306_cmd(0x20); ssd1306_cmd(0x00);   // Horizontal
  ssd1306_cmd(0xA1);                      // 左右翻转可改 A0
  ssd1306_cmd(0xC8);                      // 上下翻转可改 C0
  ssd1306_cmd(0xDA); ssd1306_cmd(0x12);
  ssd1306_cmd(0x81); ssd1306_cmd(0x7F);
  ssd1306_cmd(0xD9); ssd1306_cmd(0xF1);
  ssd1306_cmd(0xDB); ssd1306_cmd(0x40);
  ssd1306_cmd(0xA4);
  ssd1306_cmd(0xA6);
  ssd1306_cmd(0xAF);

  SSD1306_Fill(0);
  SSD1306_Update();
}

/* =========================================================================
 *  放大/加粗/居中渲染（基于上面的 FONT5x7 和 SSD1306_DrawPixel）
 * ========================================================================= */

/* 计算单行文本宽度 */
int SSD1306_StringWidth6x8(const char* s){
  int w = 0;
  while (*s && *s != '\n'){ w += 6; s++; }  // 5列字 + 1列间隔
  return w;
}

/* 放大绘制单个字符：
 * sx/sy 为缩放倍数（2=约12×16，3=约18×24）
 * bold>0 时在横向右侧额外加1列像素，形成“伪粗”
 */
void SSD1306_DrawCharScaled(int x,int y,char c, uint8_t sx, uint8_t sy, uint8_t bold){
  if (c < 0x20 || c > 0x7E) c = '?';
  const uint8_t* col = FONT5x7[(uint8_t)c - 0x20];   // 5 列 × 7 行

  for (int i = 0; i < 5; i++){
    uint8_t bits = col[i];
    for (int j = 0; j < 7; j++){
      if (bits & (1 << j)){
        int px = x + i * sx;
        int py = y + j * sy;
        for (int dy = 0; dy < sy; ++dy){
          for (int dx = 0; dx < sx; ++dx){
            SSD1306_DrawPixel(px + dx, py + dy, 1);
          }
          if (bold){
            SSD1306_DrawPixel(px + sx, py + dy, 1);   // 右侧加粗 1 列
          }
        }
      }
    }
  }
}

/* 放大绘制字符串 */
void SSD1306_DrawStringScaled(int x,int y,const char* s, uint8_t sx, uint8_t sy, uint8_t bold){
  int cx = x, cy = y;
  while (*s){
    if (*s == '\n'){ cy += 8 * sy; cx = x; s++; continue; }
    SSD1306_DrawCharScaled(cx, cy, *s++, sx, sy, bold);
    cx += 6 * sx;                                   // 5列字 +1列间隔
    if (cx + 6 * sx >= SSD1306_WIDTH){ cy += 8 * sy; cx = x; }
  }
}

/* 居中绘制 */
void SSD1306_DrawStringCenteredScaled(int y,const char* s, uint8_t sx, uint8_t sy, uint8_t bold){
  int w = SSD1306_StringWidth6x8(s) * sx;
  int x = (SSD1306_WIDTH - w) / 2;
  if (x < 0) x = 0;
  SSD1306_DrawStringScaled(x, y, s, sx, sy, bold);
}
